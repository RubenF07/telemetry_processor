VERSION ""

NS_ :

BS_:

BU_: TestECU

BO_ 100 Motor_Speed: 8 TestECU
 SG_ Motor_Speed : 0|16@1+ (0.01,0) [0|8000] "RPM" TestECU

BO_ 200 Motor_Torque: 8 TestECU
 SG_ Motor_Torque : 0|16@1+ (0.01,0) [0|500] "Nm" TestECU

BO_ 300 Battery_Temp: 8 TestECU
 SG_ Battery_Temp : 0|16@1+ (0.01,0) [0|120] "degC" TestECU

BO_ 400 Battery_Voltage: 8 TestECU
 SG_ Battery_Voltage : 0|16@1+ (0.01,0) [0|600] "V" TestECU
